## main/Kconfig.projbuild
```kconfig
menu "Temperature sensor"
    config SDA_PIN
        int "I2C SDA pin number"
        default 19
        help
            The ESP32 GPIO pin used to connect to the SHTs I2C SDA pin

    config SCL_PIN
        int "I2C SCL pin number"
        default 20
        help
            The ESP32 GPIO pin used to connect to the SHTs I2C SCL pin

    config NTP_SRV
        string "NTP server hostname"
        default "ch.pool.ntp.org"
        help
            Public NTP time server to synchronize the system time, for meaningful timestamping

    config MEASUREMENT_INTERVAL_SECONDS
        int "Measurement interval (seconds)"
        default 3600
        help
            Sleep time between reading the SHTs temperature and humidity and storing them to RTC RAM (ringbuffer of 512 entries)

    config SYNCHRONIZATION_INTERVAL_SECONDS
        int "Synchronization interval (seconds)"
        default 86400
        help
            Minimum interval before reporting stored measurements via MQTT and re-synchronizing the RTC clock (from NTP server)

    config MQTT_BROKER_HOSTNAME
        string "MQTT broker hostname"
        default "test.mosquitto.org"
        help
            MQTT broker for published measurements

    config MQTT_TOPIC_ROOT
        string "MQTT root topic"
        default "random237865235/tempsensor"
        help
            The prefix to the MQTT topic - can be extended using console setup

    config MQTT_USE_TLS
        bool "MQTT use encryption (TLS)"
        default false
        help
            Connect to broker using TLS. The public key file of the certificate authority (CA) that was used to sign the brokers public key needs to be present in main/security/ca.crt

    if MQTT_USE_TLS
    config MQTT_TLS_CLIENT_AUTH
    depends on MQTT_USE_TLS
    bool "MQTT use client authentication (TLS)"
    default false
    help
        Authenticate this client against the broker. The client certificate needs to be present in main/security/client.crt, the key in main/security/client.key
    endif
endmenu
```
